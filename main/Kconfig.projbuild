## main/Kconfig.projbuild
```kconfig
menu "BeeScale Configuration"

    config BEESCALE_OTA_URL
        string "Firmware update URL"
        default "https://github.com/fransstrom/hive-scale/releases/latest/download/beescale.bin"
        help
            HTTPS URL of the firmware image published as the latest release.

    config BEESCALE_OTA_CHECK_INTERVAL_WAKEUPS
        int "Wake cycles between OTA checks"
        range 1 2147483647
        default 1
        help
            Check every wake when set to 1. With the default five-minute sleep
            interval, set this to 288 to check approximately once per day.

    config BEESCALE_COMMUNICATION_RETRY_SECONDS
        int "Total Wi-Fi and MQTT retry window in seconds"
        range 1 1800
        default 120
        help
            Maximum total time spent connecting Wi-Fi, synchronizing time,
            connecting MQTT, and waiting for publish acknowledgements. Pending
            measurements remain in flash when this window expires.

    config BEESCALE_DEEP_SLEEP_SECONDS
        int "Deep sleep duration in seconds"
        range 1 86400
        default 300

    config BEESCALE_MEASUREMENT_QUEUE_CAPACITY
        int "Maximum queued measurements"
        range 2016 2304
        default 2304
        help
            2304 samples retain eight days of measurements at five-minute
            intervals. A full queue preserves old, unacknowledged records and
            reports an error instead of silently overwriting them.

    config GPIO_HX711_SCK
        int "SCK gpio pin for HX711 module"
        range 1 12
        default 4
    
    config GPIO_HX711_DOUT
        int "DOUT gpio pin for HX710 module"
        range 1 12
        default 5

    config HX711_ZERO_OFFSET
        int "HX711 zero offset"
        default 99050
        help
            Average raw reading with no load on the scale.

    config HX711_COUNTS_PER_KG
        int "HX711 counts per kilogram"
        default 10500
        help
            Difference between the loaded and unloaded raw readings divided
            by the known calibration weight in kilograms. This value may be
            negative when the load cell polarity is reversed.



endmenu
```

## sdkconfig.defaults
```kconfig
CONFIG_IDF_TARGET="esp32c3"
CONFIG_ESPTOOLPY_FLASHSIZE_4MB=y
CONFIG_PARTITION_TABLE_CUSTOM=y
CONFIG_PARTITION_TABLE_CUSTOM_FILENAME="partitions.csv"
CONFIG_BOOTLOADER_APP_ROLLBACK_ENABLE=y
CONFIG_MBEDTLS_CERTIFICATE_BUNDLE=y

#OTA CONFIG
CONFIG_BEESCALE_OTA_URL="https://github.com/fransstrom/hive-scale/releases/latest/download/beescale.bin"

#CYCLE CONFIG
CONFIG_BEESCALE_OTA_CHECK_INTERVAL_WAKEUPS=1
CONFIG_BEESCALE_COMMUNICATION_RETRY_SECONDS=120
CONFIG_BEESCALE_DEEP_SLEEP_SECONDS=300
CONFIG_BEESCALE_MEASUREMENT_QUEUE_CAPACITY=2304

#HX711
CONFIG_GPIO_HX711_DOUT=5
CONFIG_GPIO_HX711_SCK=4
```
